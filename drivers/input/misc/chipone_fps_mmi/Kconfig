## drivers/input/misc/chipone_fps_mmi/Kconfig
```kconfig
config INPUT_CHIPONE_FPS_MMI
	tristate "MMI Chipone fingerprint sensor"
	default n
	help
	  Say Y here if you wish to include support for MMI Chipone fingerprint sensor.
	  If unsure, say N.

config INPUT_CHIPONE_FPS_MMI_SUPPORT_POWER_GPIO
	bool "Power GPIO support for MMI Chipone fingerprint sensor"
	default n
	depends on INPUT_CHIPONE_FPS_MMI
	help
	  Say Y here if you wish to include power gpio support for MMI Chipone fingerprint sensor.
	  If unsure, say N.
```

## drivers/input/misc/ets_bix_mmi/Kconfig
```kconfig
config INPUT_ETS_BIX_MMI
	tristate "MMI ETS BIX fingerprint sensor"
	default n
	help
	  Say Y here if you wish to include support for MMI ETS BIX fingerprint sensor.
	  If unsure, say N.
```

## drivers/input/misc/silead_fps_mmi/Kconfig
```kconfig
config INPUT_SILEAD_FPS_MMI
	tristate "MMI Silead fingerprint sensor"
	default n
	help
	  Say Y here if you have an MMI Silead fingerprint sensor in your system.

	  To compile this driver as a module, choose M here: the
	  module will be called silead_fps_mmi.
```

## drivers/input/touchscreen/focaltech_0flash_v2_mmi/Kconfig
```kconfig
#
# Focaltech Touchscreen driver configuration
#

config TOUCHSCREEN_FTS_0FLASH_MMI_V2
	tristate "Focaltech 0flash MMI Touchscreen V2"
	default n
	help
	  Say Y here if you have Focaltech 0flash MMI V2 touch panel.
	  If unsure, say N.

config TOUCHSCREEN_FTS_0FLASH_MMI_V2_ENABLE_DOUBLE_TAP
	bool "Enable double tap"
	depends on TOUCHSCREEN_FTS_0FLASH_MMI_V2
	default n
	help
	  Say Y here to enable double tap functionality on Focaltech 0flash MMI V2 touch panel.
	  If unsure, say N.

config TOUCHSCREEN_FTS_0FLASH_MMI_V2_NOTIFY_TOUCH_STATE
	bool "Enable touch state"
	depends on TOUCHSCREEN_FTS_0FLASH_MMI_V2
	default n
	help
	  Say Y here to enable touch state reporting on Focaltech 0flash MMI V2 touch panel.
	  If unsure, say N.

config TOUCHSCREEN_FTS_0FLASH_MMI_V2_ESD_EN
	bool "Enable ESD"
	depends on TOUCHSCREEN_FTS_0FLASH_MMI_V2
	default n
	help
	  Say Y here to enable ESD functionality on Focaltech 0flash MMI V2 touch panel.
	  If unsure, say N.

config TOUCHSCREEN_FTS_0FLASH_MMI_V2_PANEL_NOTIFICATIONS
	bool "Enable panel notifications"
	depends on TOUCHSCREEN_FTS_0FLASH_MMI_V2
	default n
	help
	  Say Y here to enable panel notifications on Focaltech 0flash MMI V2 touch panel.
	  If unsure, say N.

config TOUCHSCREEN_FTS_0FLASH_MMI_V2_DEBUG_EN
	bool "Enable debug"
	depends on TOUCHSCREEN_FTS_0FLASH_MMI_V2
	default n
	help
	  Say Y here to enable debug functionality on Focaltech 0flash MMI V2 touch panel.
	  If unsure, say N.

config TOUCHSCREEN_FTS_0FLASH_MMI_V2_IC_NAME_FT8057
	bool "Enable FT8057 IC"
	depends on TOUCHSCREEN_FTS_0FLASH_MMI_V2
	default n
	help
	  Say Y here to enable FT8057 IC on Focaltech 0flash MMI V2 touch panel.
	  If unsure, say N.

config TOUCHSCREEN_FTS_0FLASH_MMI_V2_PINCTRL_EN
	bool "Enable pin control"
	depends on TOUCHSCREEN_FTS_0FLASH_MMI_V2
	default n
	help
	  Say Y here to enable pin control functionality on Focaltech 0flash MMI V2 touch panel.
	  If unsure, say N.

config TOUCHSCREEN_FTS_0FLASH_MMI_V2_LAST_TIME
	bool "Enable last time"
	depends on TOUCHSCREEN_FTS_0FLASH_MMI_V2
	default n
	help
	  Say Y here to enable last time functionality on Focaltech 0flash MMI V2 touch panel.
	  If unsure, say N.
```

## drivers/input/touchscreen/nova_0flash_mmi/Kconfig
```kconfig
#
# Novatek NT36xxx touchscreen driver configuration
#
menuconfig TOUCHSCREEN_NT36xxx_HOSTDL_SPI_MMI
	tristate "Moto Novatek NT36xxx host download SPI driver"
	default n
	help
	  Say Y here if you have a Moto Novatek NT36xxx no flash touchscreen
	  connected to your system by SPI bus.

	  If unsure, say N.

if TOUCHSCREEN_NT36xxx_HOSTDL_SPI_MMI

config TOUCHSCREEN_NOVA_0FLASH_MMI_ENABLE_DOUBLE_TAP
	bool "Moto Novatek NT36xxx double tap"
	depends on SENSORS_CLASS
	default n
	help
	  Say Y here if you want to have double tap support on Moto Novatek
	  NT36xxx.

	  If unsure, say N.

config TOUCHSCREEN_NOVA_0FLASH_MMI_NOTIFY_TOUCH_STATE
	bool "Moto Novatek NT36xxx notify touch state"
	default n
	help
	  Say Y here if you want to have touch state notification support on
	  Moto Novatek NT36xxx.

	  If unsure, say N.

config TOUCHSCREEN_NOVA_0FLASH_MMI_LAST_TIME
	bool "Moto Novatek NT36xxx touch last time"
	default n
	help
	  Say Y here if you want to have touch last time support on Moto Novatek
	  NT36xxx.

	  If unsure, say N.

config TOUCHSCREEN_NOVA_0FLASH_MMI_HIGH_RESOLUTION_N
	bool "Moto Novatek NT36xxx high resolution"
	default n
	help
	  Say Y here if you want to have high resolution support on Moto Novatek
	  NT36xxx.

	  If unsure, say N.

config TOUCHSCREEN_NOVA_0FLASH_MMI_STOWED_MODE_EN
	bool "Moto Novatek NT36xxx stowed mode"
	default n
	help
	  Say Y here if you want to have stowed mode support on Moto Novatek
	  NT36xxx.

	  If unsure, say N.

config TOUCHSCREEN_NOVA_0FLASH_MMI_PANEL_NOTIFICATIONS
	bool "Moto Novatek NT36xxx panel notifications"
	default n
	help
	  Say Y here if you want to have panel notifications support on Moto
	  Novatek NT36xxx.

	  If unsure, say N.

config TOUCHSCREEN_NOVA_0FLASH_MMI_DRM_PANEL
	bool "Moto Novatek NT36xxx DRM panel"
	default n
	help
	  Say Y here if you want to have DRM panel support on Moto Novatek
	  NT36xxx.

	  If unsure, say N.

config TOUCHSCREEN_NOVA_0FLASH_MMI_CHIP_VER_1
	bool "Moto Novatek NT36xxx touch chip ver 1"
	default n
	help
	  Say Y here if you want to have touch chip ver 1 support on Moto
	  Novatek NT36xxx.

	  If unsure, say N.

config TOUCHSCREEN_NOVA_0FLASH_MMI_ESD_ENABLE
	bool "Moto Novatek NT36xxx ESD detection"
	default n
	help
	  Say Y here if you want to have ESD detection support on Moto Novatek
	  NT36xxx.

	  If unsure, say N.

config TOUCHSCREEN_NOVA_0FLASH_MMI_LCM_FAST_LIGHTUP
	bool "Moto Novatek NT36xxx lcm fast lightup"
	default n
	help
	  Say Y here if you want to have lcm fast lightup support on Moto
	  Novatek NT36xxx.

	  If unsure, say N.

config TOUCHSCREEN_NOVA_0FLASH_MMI_STYLUS_PALM
	bool "Moto Novatek NT36xxx stylus palm"
	default n
	help
	  Say Y here if you want to have stylus palm support on Moto Novatek
	  NT36xxx.

	  If unsure, say N.

config TOUCHSCREEN_NOVA_0FLASH_MMI_STYLUS_PALM_RANGE
	bool "Moto Novatek NT36xxx stylus palm range"
	default n
	help
	  Say Y here if you want to have stylus palm range support on Moto
	  Novatek NT36xxx.

	  If unsure, say N.

config TOUCHSCREEN_NOVA_0FLASH_MMI_PEN_NOTIFIER
	bool "Moto Novatek NT36xxx pen notifier"
	depends on MISC_BU520XX_PEN
	default n
	help
	  Say Y here if you want to have pen notifier support on Moto Novatek
	  NT36xxx.

	  If unsure, say N.

config TOUCHSCREEN_NOVA_0FLASH_MMI_EDGE_SUPPRESSION
	bool "Moto Novatek NT36xxx edge touch suppression"
	default n
	help
	  Say Y here if you want to have edge touch suppression support on Moto
	  Novatek NT36xxx.

	  If unsure, say N.

config TOUCHSCREEN_NOVA_0FLASH_MMI_WAKEUP_GESTURE_CTRL
	bool "Moto Novatek NT36xxx wakeup gesture control"
	default n
	help
	  Say Y here if you want to have wakeup gesture control support on Moto
	  Novatek NT36xxx.

	  If unsure, say N.

config TOUCHSCREEN_NOVA_0FLASH_MMI_SPI_SM8450
	bool "Moto Novatek NT36xxx SPI sm8450"
	default n
	help
	  Say Y here if you want to have SPI sm8450 support on Moto Novatek
	  NT36xxx.

	  If unsure, say N.

config TOUCHSCREEN_NOVA_0FLASH_MMI_DDA_STYLUS
	bool "Moto Novatek NT36xxx DDA stylus"
	default n
	help
	  Say Y here if you want to have DDA stylus support on Moto Novatek
	  NT36xxx.

	  If unsure, say N.

endif
```

## drivers/misc/pen/Kconfig
```kconfig
config MISC_BU520XX_PEN
	tristate "Rohm BU520xx Pen Driver"
	default n
	help
	  Say Y here if you have an Rohm BU520xx pen in your system.

	  To compile this driver as a module, choose M here: the
	  module will be called bu520xx_pen.
```

## drivers/power/Kconfig
```kconfig
# SPDX-License-Identifier: GPL-2.0-only
source "drivers/power/avs/Kconfig"
source "drivers/power/reset/Kconfig"
source "drivers/power/supply/Kconfig"

config MMI_QC3P_TURBO_CHARGER
	bool "Enable MMI QC3P Turbo Charger"
	default n
	help
	  Say Y here if you have a MMI QC3P turbo charger compatible device connected.
	  If unsure, say N.

config MMI_QC3P_WT6670_DETECTED
	bool "Enable MMI QC3P WT6670 detection"
	default n
	help
	  Say Y here to enable MMI QC3P WT6670 detection.
	  If unsure, say N.

config MMI_QC3P_Z350_DETECTED
	bool "Enable MMI QC3P Z350 detection"
	default n
	help
	  Say Y here to enable MMI QC3P Z350 detection.
	  If unsure, say N.

config MMI_EXT_CHG_LED
	bool "Enable MMI external charger LED"
	default n
	help
	  Say Y here if you have a MMI external charger LED.
	  If unsure, say N.

source "drivers/power/bq2589x_chg_mmi/Kconfig"
source "drivers/power/bq2597x_mmi_iio/Kconfig"
source "drivers/power/bq25980_mmi_iio/Kconfig"
source "drivers/power/cps4019_wls_charger/Kconfig"
source "drivers/power/cw2217b_fg_mmi/Kconfig"
source "drivers/power/mmi_charger/Kconfig"
source "drivers/power/mmi_discrete_charger/Kconfig"
source "drivers/power/mmi_discrete_turbo_charger/Kconfig"
source "drivers/power/mmi_parallel_charger_iio/Kconfig"
source "drivers/power/mmi-smbcharger-iio/Kconfig"
source "drivers/power/mm8013c_fg_mmi/Kconfig"
source "drivers/power/qpnp_adaptive_charge/Kconfig"
source "drivers/power/rt9426a_fg_mmi/Kconfig"
source "drivers/power/sd77426_fg_mmi/Kconfig"
source "drivers/power/sgm4154x_chg_mmi/Kconfig"
source "drivers/power/sm5602_fg_mmi/Kconfig"
```

## drivers/power/mmi-smbcharger-iio/Kconfig
```kconfig
config MMI_SMBCHARGER_IIO
	tristate "MMI SMBCHARGER IIO"
	default n
	help
	  Say Y here if you have a mmi smbcharger iio compatible
	  device connected.

	  This driver can also be built as a module.  If so, the module
	  will be called mmi-smbcharger-iio.

config QG_LEGACY
	bool "Legacy behavior for QG fuel gauge (disable SOH)"
	depends on MMI_SMBCHARGER_IIO
	default n
	help
	  Says Y if you want to disable QG SOH channel and use legacy
	  battery detection path.
```

## drivers/power/rt9426a_fg_mmi/Kconfig
```kconfig
config RT9426A_FG_MMI
	tristate "RT9426A MMI fuel gauge"
	default n
	help
	  Say Y here if you have an RT9426A MMI fuel gauge in your system.

	  To compile this driver as a module, choose M here: the
	  module will be called rt9426a_fg_mmi.
```

## drivers/power/sd77426_fg_mmi/Kconfig
```kconfig
config SD77426_FG_MMI
	tristate "SD77426 MMI fuel gauge"
	default n
	help
	  Say Y here if you have an SD77426 MMI fuel gauge in your system.

	  To compile this driver as a module, choose M here: the
	  module will be called sd77426_fg_mmi.
```

## drivers/regulator/ocp2138/Kconfig
```kconfig
config REGULATOR_OCP2138
	tristate "OCP2138 REGULATOR"
	default n
	help
	  Say Y here if you have a OCP2138 compatible
	  device connected.

	  This driver can also be built as a module.  If so, the module
	  will be called wl2868c.
```

## drivers/regulator/wl2866d/Kconfig
```kconfig
config REGULATOR_WL2866D
	tristate "WL2866D REGULATOR"
	default n
	help
	  Say Y here if you have an Wl2866d regulartor in your system.

	  To compile this driver as a module, choose M here: the
	  module will be called wl2866d.
```
